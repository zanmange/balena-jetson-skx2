## layers/meta-balena-jetson/conf/machine/blackboard-tx2.conf
```bitbake
#@TYPE: Machine
##@NAME: blackboard-tx2
##@DESCRIPTION: Machine configuration for the blackboard

MACHINEOVERRIDES = "jetson-tx2:${MACHINE}"
include conf/machine/jetson-tx2.conf
```

## layers/meta-resin-jetson/conf/layer.conf
```bitbake
BBPATH .= ":${LAYERDIR}"

BBFILES += "${LAYERDIR}/recipes-*/*/*.bb \
            ${LAYERDIR}/recipes-*/*/*.bbappend"

BBFILE_COLLECTIONS += "resin-jetson"
BBFILE_PATTERN_resin-jetson := "^${LAYERDIR}/"
BBFILE_PRIORITY_resin-jetson = "1337"

GCCVERSION = "6.%"

# kernel-image is installed by meta-tegra. We use kernel-image-initramfs
# Remove kernel-image package
MACHINE_ESSENTIAL_EXTRA_RDEPENDS_remove = "kernel-image"

MACHINE_ESSENTIAL_EXTRA_RRECOMMENDS += "tegra-nvpmodel tegra-configs-nvstartup tegra-configs-udev"
```

## layers/meta-resin-jetson/conf/machine/SKX2.conf
```bitbake
#@TYPE: Machine
##@NAME: SKX2
##@DESCRIPTION: Machine configuration for the SKX2

MACHINEOVERRIDES = "jetson-tx2:${MACHINE}"
include conf/machine/jetson-tx2.conf
```

## layers/meta-resin-jetson/conf/machine/jetson-tx2-skycatch.conf
```bitbake
#@TYPE: Machine
##@NAME: Nvidia Jetson TX2 with Skycatch carrier board
##@DESCRIPTION: Machine configuration for the Nvidia Jetson TX2 with Skycatch carrier board

MACHINEOVERRIDES = "jetson-tx2:${MACHINE}"
include conf/machine/jetson-tx2.conf
```
